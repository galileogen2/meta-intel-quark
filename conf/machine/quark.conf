## conf/machine/quark.conf
```bitbake
#@TYPE: Machine
#@NAME: quark

#@DESCRIPTION: Machine configuration for Quark systems

PREFERRED_PROVIDER_virtual/kernel ?= "linux-yocto-quark"
PREFERRED_VERSION_linux-yocto-quark ?= "3.8%"

require conf/machine/include/x86-base.inc
include conf/machine/include/tune-i586.inc

#Avoid pulling in GRUB
MACHINE_ESSENTIAL_EXTRA_RDEPENDS = ""

MACHINE_FEATURES = "efi usb pci"

SERIAL_CONSOLE = "115200 ttyS1"
#SERIAL_CONSOLES = "115200;ttyS0 115200;ttyS1"

EXTRA_IMAGEDEPENDS = "grub"
PREFERRED_VERSION_grub = "0.97+git%"

module_autoload_ad7298 = "ad7298"
module_autoload_spidev = "spidev"
module_autoload_hcd = "ehci_hcd ohci_hcd ehci-pci"
module_autoload_usb_storage = "usb_storage"
module_autoload_cy8c9540a = "pch-udc g_acm_ms gpio_sch intel_qrk_gip cy8c9540a"
module_conf_g_acm_ms = "options g_acm_ms file=/dev/mmcblk0p1 removable=1 idVendor=0x8086 idProduct=0xBABE Manufacturer=Intel iProduct=IOTDK"
module_conf_intel_qrk_gip = "options intel_qrk_gip i2c_std_mode=1"
module_autoload_at24 = "at24"
module_autoload_i2c-dev = "i2c-dev"
module_autoload_spidev = "spidev"
module_autoload_mtd = "mtd"
module_autoload_spi-pxa2xx = "spi-pxa2xx"
module_autoload_spi-pxa2xx-pci = "spi-pxa2xx-pci"
module_autoload_m25p80 = "m25p80"
module_autoload_usbhid = "usbhid"
module_autoload_stmmac = "stmmac"
```
